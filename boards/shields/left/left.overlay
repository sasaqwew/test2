/ {
    chosen {
        zmk,scan-matrix = &kb_scan_left;
    };

    kb_scan_left: matrix {
        compatible = "zmk,matrix-transform";
        rows = <8>;
        columns = <8>;

        row-gpios = <
            &gpio0 0 GPIO_ACTIVE_LOW,  // P0.00
            &gpio0 1 GPIO_ACTIVE_LOW,  // P0.01
            &gpio0 2 GPIO_ACTIVE_LOW,  // P0.02
            &gpio0 3 GPIO_ACTIVE_LOW,  // P0.03
            &gpio0 4 GPIO_ACTIVE_LOW,  // P0.04
            &gpio0 5 GPIO_ACTIVE_LOW,  // P0.05
            &gpio0 6 GPIO_ACTIVE_LOW,  // P0.06
            &gpio0 7 GPIO_ACTIVE_LOW   // P0.07
        >;

        col-gpios = <
            &gpio0 8 GPIO_ACTIVE_LOW,  // P0.08
            &gpio0 9 GPIO_ACTIVE_LOW,  // P0.09
            &gpio0 10 GPIO_ACTIVE_LOW, // P0.10
            &gpio0 11 GPIO_ACTIVE_LOW, // P0.11
            &gpio0 12 GPIO_ACTIVE_LOW, // P0.12
            &gpio0 13 GPIO_ACTIVE_LOW, // P0.13
            &gpio0 14 GPIO_ACTIVE_LOW, // P0.14
            &gpio0 15 GPIO_ACTIVE_LOW  // P0.15
        >;
    };
};
