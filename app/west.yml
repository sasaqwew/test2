## app/west.yml
```yaml
manifest:
  version: "0.7"
  remotes:
    - name: zmkfirmware
      url-base: https://github.com/zmkfirmware

  projects:
    - name: zmk
      remote: zmkfirmware
      revision: main
      import: app

  self:
    path: app
```
